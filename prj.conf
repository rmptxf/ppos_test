## CMakeLists.txt
```
#
# Copyright (c) 2018 Nordic Semiconductor
#
# SPDX-License-Identifier: LicenseRef-Nordic-5-Clause
#

cmake_minimum_required(VERSION 3.20.0)

find_package(Zephyr REQUIRED HINTS $ENV{ZEPHYR_BASE})
project(lte-ble-gateway)

# NORDIC SDK APP START
target_sources(app PRIVATE src/main.c)
# NORDIC SDK APP END
zephyr_include_directories(src)

target_sources(app PRIVATE src/aggregator.c)
target_sources(app PRIVATE src/ble.c)
target_sources(app PRIVATE src/gcloud.c)

# Include application events and configuration headers
zephyr_library_include_directories(
  include
)
```

## Kconfig
```
#
# Copyright (c) 2018 Nordic Semiconductor ASA
#
# SPDX-License-Identifier: LicenseRef-Nordic-5-Clause
#

menu "PPOS Gateway Settings"

config APP_VERSION
	string "Application version"
	default "v1.0.0"

config PUBLICATION_INTERVAL_SECONDS
	int "Interval in seconds that the sample will publish data"
	default 60

config CONNECTION_RETRY_TIMEOUT_SECONDS
	int "Number of seconds between each GCP IoT connection retry"
	default 30

endmenu


config DATE_TIME_UPDATE_INTERVAL_SECONDS
    int "Date time update interval, in seconds"
    default 10

config GCLOUD_WATCHDOG_TIMEOUT_MSEC
    int "Watchdog timeout in milliseconds"
    default 10000
    
menuconfig DATE_TIME
    bool "Date time library"
    select AT_CMD
    select SNTP
    depends on BSD_LIBRARY

menu "Environment sensors"

    config TEMP_DEV_NAME
        string "Temperature device name"
        help
            Device from which temperature data will be fetched and
            sent to nRF Cloud.

    config USE_BME680_BSEC
        bool "Use Bosch BME680 BSEC lib"
        default y
        help
            Enable use of Bosch BSEC library. The library itself is not a part of
            NCS and must be downloaded from Bosch Sensortec.
    
    config BOSCH_BSEC_LIBRARY_PATH
        string "Path to Bosch BSEC library folder"
        default "$(ZEPHYR_BASE)/../nrf/ext/BSEC_1.4.7.4_Generic_Release"
        help
            Path to the folder where the Bosch BSEC library is placed.

    config ENVIRONMENT_DATA_SEND_INTERVAL
        int "Interval in seconds for sending environment data"
        default 30
        help
            Interval between each sampling and sending of environment sensor data.
            If the GPS is active, sensor data will not be sent before it is
            stopped. The unit is seconds.
    
    config ENVIRONMENT_DATA_BACKOFF_TIME
        int "Time to delay sending environment data if GPS active"
        default 20
        help
            Time in seconds before retrying to send environment sensor data if
            the GPS is active.

endmenu # Environment sensors

config PRINTK
    bool "Send printk() to console"
    default y
    help
        This option directs printk() debugging output to the supported
        console device, rather than suppressing the generation
        of printk() output entirely. Output is sent immediately, without
        any mutual exclusion or buffering.


config MQTT_MESSAGE_BUFFER_SIZE
    int "MQTT message buffer size"
    default 256

config MQTT_PAYLOAD_BUFFER_SIZE
    int "MQTT payload buffer size"
    default 256

config GCLOUD_LOG_LEVEL
    int "App log level"
    default 4
        
# Include Zephyr's Kconfig

menu "Zephyr Kernel"
source "Kconfig.zephyr"
endmenu
```

## sample.yaml
```
sample:
  name: LTE-BLE gateway sample
tests:
  samples.nrf9160.lte_ble_gateway:
    build_only: true
    platform_allow: nrf9160dk_nrf9160_ns
    integration_platforms:
      - nrf9160dk_nrf9160_ns
    tags: ci_build
common:
  tags: net mqtt cloud
  harness: net
  filter: TOOLCHAIN_HAS_NEWLIB == 1
```

## prj.conf
```kconfig
#
# Copyright (c) 2019 Nordic Semiconductor ASA
#
# SPDX-License-Identifier: LicenseRef-Nordic-5-Clause
#
# General config
CONFIG_NEWLIB_LIBC=y
CONFIG_ASSERT=y
CONFIG_REBOOT=y

# Network
CONFIG_NETWORKING=y
CONFIG_NET_NATIVE=n
CONFIG_NET_SOCKETS=y
CONFIG_NET_SOCKETS_OFFLOAD=y

# LTE link control
CONFIG_LTE_LINK_CONTROL=y
CONFIG_LTE_AUTO_INIT_AND_CONNECT=n

# AT host
#CONFIG_AT_HOST_LIBRARY=n

# Modem library
CONFIG_NRF_MODEM_LIB=y

# Disable Modem traces, since we need UART1 for HCI
CONFIG_NRF_MODEM_LIB_TRACE_ENABLED=n

# nRF Cloud
CONFIG_NRF_CLOUD_MQTT=y
CONFIG_NRF_CLOUD_CONNECTION_POLL_THREAD=n

# The two configurations below are required if using the nRF9160's built-in GPS
# CONFIG_NRF9160_GPS=y
# CONFIG_GPS_USE_NRF9160=y

# Library for buttons and LEDs
CONFIG_DK_LIBRARY=y
CONFIG_DK_LIBRARY_INVERT_LEDS=n

# Console for user association
CONFIG_CONSOLE_SUBSYS=y
CONFIG_CONSOLE_GETCHAR=y

# Enable Bluetooth stack and libraries
CONFIG_BT=y
CONFIG_BT_H4=y
CONFIG_BT_WAIT_NOP=y
CONFIG_BT_CENTRAL=y
CONFIG_BT_GATT_CLIENT=y
CONFIG_BT_GATT_DM=y
CONFIG_BT_SCAN=y
CONFIG_BT_SCAN_FILTER_ENABLE=y
CONFIG_BT_SCAN_UUID_CNT=1

CONFIG_UART_INTERRUPT_DRIVEN=y

# Heap and stacks
CONFIG_HEAP_MEM_POOL_SIZE=16384
CONFIG_MAIN_STACK_SIZE=8192


CONFIG_LOG=y

CONFIG_NETWORKING=y
CONFIG_STDOUT_CONSOLE=y

# This shouldn't need to be set, but isn't selected properly.
CONFIG_NEWLIB_LIBC=y

# Configure MQTT
CONFIG_MQTT_LIB=y
CONFIG_MQTT_LIB_TLS=y
CONFIG_NET_SOCKETS_SOCKOPT_TLS=y

# GCLOUD MQTT broker configurations
#CONFIG_CLOUD_CLIENT_ID="projects/ppos-web-app-cloud/locations/us-central1/registries/registry/devices/nRF9160DK_0"
#CONFIG_CLOUD_AUDIENCE="ppos-web-app-cloud"
#CONFIG_CLOUD_PUB_TOPIC="/devices/nRF9160DK_0/state"
#CONFIG_CLOUD_SUB_TOPIC="/devices/nRF9160DK_0/config"
#CONFIG_CLOUD_BROKER_HOSTNAME="mqtt.2030.ltsapis.goog"
#CONFIG_CLOUD_BROKER_PORT=8883
#CONFIG_PUBLISH_ID=123
#CONFIG_SUBSCRIBE_ID=124

CONFIG_MQTT_MESSAGE_BUFFER_SIZE=1024
CONFIG_MQTT_PAYLOAD_BUFFER_SIZE=1024

# sec tags for CA's and private key
#CONFIG_CLIENT_SEC_TAG=10
#CONFIG_GOOGLE_CA_CERT_1_SEC_TAG=202
#CONFIG_GOOGLE_CA_CERT_2_SEC_TAG=203

# nRF Additions
CONFIG_NRF_MODEM_LIB=y
CONFIG_NRF_MODEM_LIB_SYS_INIT=n
# nRF9160 Modem-based JWT: https://developer.nordicsemi.com/nRF_Connect_SDK/doc/latest/nrf/libraries/modem/modem_jwt.html
CONFIG_JWT=y
CONFIG_JWT_SIGN_ECDSA=y

CONFIG_NET_NATIVE=n
#CONFIG_HEAP_MEM_POOL_SIZE=4096

# LTE link control
CONFIG_LTE_LINK_CONTROL=y
# Disable autoconnect
CONFIG_LTE_AUTO_INIT_AND_CONNECT=n
# Disable NB-IoT fallback
CONFIG_LTE_NETWORK_USE_FALLBACK=n

# CJSON
CONFIG_CJSON_LIB=y


# Date Time library
CONFIG_DATE_TIME=y
CONFIG_DATE_TIME_MODEM=n


# BSD library
CONFIG_DATE_TIME_UPDATE_INTERVAL_SECONDS=3600
CONFIG_SNTP=y

# nRF9160 helper libraries
CONFIG_MODEM_KEY_MGMT=y
CONFIG_MODEM_INFO=y
```

## src/main.c
```c
/*
 * Copyright (c) 2020 Safecility.com
 * Author: tad@safecility.com
 */

#include <zephyr.h>
#include <device.h>

#include <stdio.h>
#include <stdlib.h>
#include <string.h>
#include <errno.h>

#include <power/reboot.h>

#include <nrf_modem.h>
#include <modem/lte_lc.h>
#include <modem/modem_info.h>

#include <nrf_socket.h>
#include <net/socket.h>
#include <net/mqtt.h>

#include <date_time.h>
#include <gcloud.h>
#include <cJSON.h>

/* Size of buffer determines update rate */
#define MAX_MESSAGE_SIZE 256

struct app_message {
	char data[MAX_MESSAGE_SIZE];
	size_t len;
};

/* Register main module log */
LOG_MODULE_REGISTER(google_mqtt, CONFIG_GCLOUD_LOG_LEVEL);

/* Stack definition for application */
static K_THREAD_STACK_DEFINE(gc_stack_area, 4096);

/* Threads */
static struct k_thread gc_thread;

k_tid_t gc_tid;

struct m_info_t
{
    char cid[30];
    char tac[30];
    char rssi[30];
    char apn[60];
    char fwv[60];
    uint16_t vltg;
    uint16_t temp;
};

/* Semaphores */
static K_SEM_DEFINE(date_time_ok, 0, 1);

/* Global Variables */

/* Forward declarations of functions */
static void store_modem_configuration(void);

/* Handlers */
void button_handler(uint32_t button_state, uint32_t has_changed)
{
    LOG_INF("Button event: %x  %x\n", button_state, has_changed);
    if ((has_changed & 0x01) && (button_state & 0x01))
    {
        store_modem_configuration();
    }
}

/**@brief Handler for when receiving data from Google Cloud */
void received_config_handler(const struct mqtt_publish_message *message)
{

    cJSON *data_json = cJSON_Parse(message->payload.data);
    cJSON_Delete(data_json);
}

/**@brief Configures modem to provide LTE link. Blocks until link is
 * successfully established
 */
static void modem_configure(void)
{
    if (IS_ENABLED(CONFIG_LTE_AUTO_INIT_AND_CONNECT))
    {
        /* Do nothing, modem is already turned on and connected */
    }
    else
    {
        int err;

        //LOG_INF("Enabling PSM\n");
        /* Enable PSM mode */
        //lte_lc_psm_req(true);

        LOG_INF("Establishing LTE link\n");
        err = lte_lc_init_and_connect();
        __ASSERT(err == 0, "LTE link could not be established. Rebooting\n");
    }
}

/**@brief Soft boots modem to store current values to NVM */
void store_modem_configuration(void)
{
    int err;

    LOG_INF("Storing modem configuration\n");
    err = lte_lc_power_off();
    if (err)
    {
        LOG_INF("Fail turning off modem: %d\n", err);
    }
    LOG_INF("Modem offline, turning back on\n");

    err = lte_lc_normal();
    if (err)
    {
        LOG_INF("Fail turning on modem: %d\n", err);
    }
    LOG_INF("Done\n");
}

/**@brief Return modem information */
void get_modem_info(struct m_info_t *info)
{
    LOG_INF("Getting modem info\n");
    modem_info_string_get(MODEM_INFO_CELLID, info->cid, sizeof(info->cid));
    modem_info_string_get(MODEM_INFO_AREA_CODE, info->tac, sizeof(info->tac));
    modem_info_string_get(MODEM_INFO_RSRP, info->rssi, sizeof(info->rssi));
    modem_info_string_get(MODEM_INFO_APN, info->apn, sizeof(info->apn));
    modem_info_string_get(MODEM_INFO_FW_VERSION, info->fwv, sizeof(info->fwv));
    modem_info_short_get(MODEM_INFO_BATTERY, &info->vltg);
    modem_info_short_get(MODEM_INFO_TEMP, &info->temp);
}

void date_time_handler(const struct date_time_evt *evt) {

	switch (evt->type)
	{
	case DATE_TIME_OBTAINED_MODEM:
		LOG_DBG("DATE_TIME: got time from modem.\n");
		k_sem_give(&date_time_ok);
		break;
	case DATE_TIME_OBTAINED_NTP:
		LOG_DBG("DATE_TIME: got time from NTP.\n");
		k_sem_give(&date_time_ok);
		break;
	case DATE_TIME_OBTAINED_EXT:
		LOG_DBG("DATE_TIME: got time from external.\n");
		k_sem_give(&date_time_ok);
		break;
	case DATE_TIME_NOT_OBTAINED:
		LOG_DBG("DATE_TIME: failed to get time.\n");
		k_sem_give(&date_time_ok);
		break;
	default:
		break;
	}
}

void create_message(struct app_message* destination, uint8_t *data, size_t len, int64_t *timestamp) {

	cJSON *message;

	message = cJSON_CreateObject();

    cJSON_AddStringToObject(message, "type", "test message");

	char time_str[16];
	snprintf(time_str, 16, "%lld", *timestamp);

	char data_str[len];
	snprintf(data_str, len, "%s", data);

	cJSON_AddStringToObject(message, "timestamp", time_str);
	cJSON_AddStringToObject(message, "data", data);

	destination->len = strlen(cJSON_Print(message));

	strcpy(destination->data, cJSON_Print(message));

	cJSON_Delete(message);
}

/**@brief Thread initialisation */
void main(void)
{
    int err;

    LOG_INF("Google Cloud env sensor app started");

    LOG_INF("Initializing modem\n");
    modem_configure();

    LOG_INF("Initializing modem info\n");
    modem_info_init();

    date_time_update_async(date_time_handler);
    k_sem_take(&date_time_ok, K_FOREVER);

    /* Initialise Google Cloud thread */
    gc_tid = k_thread_create(&gc_thread, gc_stack_area, K_THREAD_STACK_SIZEOF(gc_stack_area),
                             (k_thread_entry_t)gcloud_thread, NULL, NULL, NULL,
                             7, 0, K_NO_WAIT);


    err = gcloud_provision();
    if (err)
    {
        LOG_ERR("Provisioning failed, error: %d\n", err);
        /* Reboot */
        sys_reboot(0); //TODO: Handle error
    }

    /* Connect to Google Cloud */
    LOG_INF("Connecting to Google Cloud\n");
    //err = gcloud_connect(received_config_handler);
    err = gcloud_connect(NULL);
    if (err)
    {
        LOG_ERR("Failed to connect to Google Cloud, error: %d\n", err);
        /* Reboot */
        sys_reboot(0); //TODO: Handle error
    }
    else
    {
        LOG_INF("Connected to Google Cloud\n");
    }
    
    int pub_success;
    uint32_t cnt = 0;

    while (true)
    {
        //Get timestamp
	    int64_t curr_time;
	    date_time_now(&curr_time);

        struct app_message message;
        create_message(&message, "x", sizeof("x"), &curr_time);

        pub_success = gcloud_publish(message.data, message.len, MQTT_QOS_1_AT_LEAST_ONCE);
        if (pub_success != 0)
        {
            LOG_INF("JSON data Publish failed\n");
        }
        
        cnt++;
        k_sleep(K_SECONDS(10));
    }
}
```

## include/gcloud.h
```c
#ifndef __GCLOUD_H__
#define __GCLOUD_H__

#include <net/mqtt.h>

#define strlens(s) (s==NULL?0:strlen(s))

typedef void (*received_config_handler_t)(const struct mqtt_publish_message *message);

/**
 * @brief Publishes data to Google Cloud.
 * 
 * @param[in] data A pointer to the data to be sent.
 * @param[in] size The size of the data to be sent.
 * @param[in] qos The Quality of Serive level to be used when sending the telemetry.
 * 
 * @note Google Cloud does only support QoS 0 and QoS 1, not QoS 2
 * 
 * @retval 0 or an error code indicating reason for failure.
 */
// CANDO: Make it possible to publish gps to subtopics
int gcloud_publish(uint8_t *data, uint32_t size, enum mqtt_qos qos);

/**
 * @brief Publishes device state to Google Cloud.
 * 
 * @param[in] data A pointer to the data to be sent.
 * @param[in] size The size of the data to be sent.
 * @param[in] qos The Quality of service level to be used when sending the state.
 * 
 * @note Google Cloud does only support QoS 0 and QoS 1, not Qos 2.
 * @note Google Cloud limits state updates to 1 update per second, per device. 
 *       However, for best results, device state should be updated much less often 
 *       - at most, once every 10 second.
 * 
 * @retval 0 or an error code indicating reson for failure.
 */
int gcloud_publish_state(uint8_t *data, uint32_t size, enum mqtt_qos qos);

/**
 * @brief Connects the device to Google Cloud, and subscribes to Google Cloud's configuration topic.
 * 
 * @note gcloud_provision must be called before this.
 * @note Shall be called before trying to send data to Google Cloud.
 * @note The modem must be turned on, and connected before this function can be called.
 * 
 * @param[in] received_config_cb Callback function which will be called when a configuration 
 *            update is received from Google Cloud.
 * 
 * @retval - or an error code indicating reason for failure.
 */
// CANDO: make it possible to set keep-alive checks, and input check intervals
// CANDO: make it possible to decide what QoS level the subscription to config should be
int gcloud_connect(received_config_handler_t received_config_cb);

/**
 * @brief Initializes the module and provisions the modem so that an TLS 
 * connection can be established to Google Cloud.
 * 
 * @note Shall be called before the modem is turned on.
 * @note Shall be called before gcloud_connect.
 * @note If module initialization fails, no module APIs shall be called.
 * 
 * @retval 0 or an error code indicating reason for failure.
 */
int gcloud_provision(void);

/**
 * @brief Disconnects the device from Google Cloud.
 * 
 * @retval 0 or an error code indicating reason for failure.
 */
int gcloud_disconnect(void);

/**
 * @brief Google Cloud Thread entry.
 */
extern void gcloud_thread(void *unused1, void *unused2, void *unused3);

#endif /* __GCLOUD_H__ */
```

## src/aggregator.c
```c
/*
 * Copyright (c) 2018 Nordic Semiconductor ASA
 *
 * SPDX-License-Identifier: LicenseRef-Nordic-5-Clause
 */
#include "aggregator.h"
#include <kernel.h>
#include <zephyr.h>
#include <stdio.h>
#include <zephyr/types.h>
#include <string.h>
#include <irq.h>

K_FIFO_DEFINE(aggregator_fifo);

static uint32_t entry_count;

struct fifo_entry {
	void *fifo_reserved;
	uint8_t data[sizeof(struct reader_data)];
};

int aggregator_put(struct reader_data in_data)
{
	struct fifo_entry *fifo_data = NULL;
	uint32_t  lock = irq_lock();
	int    err  = 0;

	if (entry_count == FIFO_MAX_ELEMENT_COUNT) {
		fifo_data = k_fifo_get(&aggregator_fifo, K_NO_WAIT);

		__ASSERT(fifo_data != NULL, "fifo_data should not be NULL");

		entry_count--;
	}

	if (fifo_data == NULL) {
		fifo_data = k_malloc(sizeof(struct fifo_entry));
	}

	if (fifo_data == NULL) {
		err = -ENOMEM;
		goto exit;
	}

	memcpy(fifo_data->data, &in_data, sizeof(struct reader_data));

	k_fifo_put(&aggregator_fifo, fifo_data);
	entry_count++;

exit:
	irq_unlock(lock);
	return err;
}

int aggregator_get(struct reader_data *out_data)
{
	void  *fifo_data;
	int   err = 0;

	if (out_data == NULL) {
		return -EINVAL;
	}

	uint32_t lock = irq_lock();

	fifo_data = k_fifo_get(&aggregator_fifo, K_NO_WAIT);
	if (fifo_data == NULL) {
		err = -ENODATA;
		goto exit;
	}

	memcpy(out_data, ((struct fifo_entry *)fifo_data)->data,
	       sizeof(struct reader_data));

	k_free(fifo_data);
	entry_count--;

exit:
	irq_unlock(lock);
	return err;
}

void aggregator_clear(void)
{
	void *fifo_data;
	uint32_t lock = irq_lock();

	while (1) {
		fifo_data = k_fifo_get(&aggregator_fifo, K_NO_WAIT);

		if (fifo_data == NULL) {
			break;
		}

		k_free(fifo_data);
	};

	entry_count = 0;
	irq_unlock(lock);
}

int aggregator_element_count_get(void)
{
	return entry_count;
}
```

## src/aggregator.h
```c
/*
 * Copyright (c) 2018 Nordic Semiconductor ASA
 *
 * SPDX-License-Identifier: LicenseRef-Nordic-5-Clause
 */

#ifndef _AGGREGATOR_H_
#define _AGGREGATOR_H_

#include <zephyr/types.h>

#define ENTRY_MAX_SIZE 20
#define FIFO_MAX_ELEMENT_COUNT 12

struct reader_data {
	uint8_t length;
	uint8_t data[ENTRY_MAX_SIZE];
};

int aggregator_init(void);

int aggregator_put(struct reader_data data);

int aggregator_get(struct reader_data *data);

void aggregator_clear(void);

int aggregator_element_count_get(void);

#endif /* _AGGREGATOR_H_ */
```

## src/ble.c
```c
/*
 * Copyright (c) 2018 Nordic Semiconductor ASA
 *
 * SPDX-License-Identifier: LicenseRef-Nordic-5-Clause
 */

#include <zephyr.h>

#include <bluetooth/bluetooth.h>
#include <bluetooth/gatt.h>
#include <bluetooth/uuid.h>
#include <bluetooth/gatt_dm.h>
#include <bluetooth/scan.h>

#include <dk_buttons_and_leds.h>
#include <sys/byteorder.h>

#include "aggregator.h"

/* Reader advertisement UUID */
#define BT_UUID_ADV_VAL \
	BT_UUID_128_ENCODE(0x6e400001, 0xb5a3, 0xf393, 0xe0a9, 0xe50e24dcca9e)
#define BT_UUID_ADV \
	BT_UUID_DECLARE_128(BT_UUID_ADV_VAL)

/* Reader service UUID (NUS) */
#define BT_UUID_NUS_VAL \
	BT_UUID_128_ENCODE(0x6e400001, 0xb5a3, 0xf393, 0xe0a9, 0xe50e24dcca9e)
#define BT_UUID_NUS \
	BT_UUID_DECLARE_128(BT_UUID_NUS_VAL)

/* Reader TX characteristic UUID */
#define BT_UUID_TX_VAL \
	BT_UUID_128_ENCODE(0x6e400003, 0xb5a3, 0xf393, 0xe0a9, 0xe50e24dcca9e)
#define BT_UUID_TX \
	BT_UUID_DECLARE_128(BT_UUID_TX_VAL)

static uint8_t on_received(struct bt_conn *conn,
			struct bt_gatt_subscribe_params *params,
			uint8_t * data, uint16_t length)
{
	if (length > 0) {
		printk("Reader data received, length:%d \n", length);
		for(uint16_t i=0; i<length; i++)
		{
			printk("data[%d]: %c\n", i, data[i]);
		}

		struct reader_data in_data;

		in_data.length = length;
		memcpy(in_data.data, data, length);

		if (aggregator_put(in_data) != 0) {
			printk("Was not able to insert reader data into aggregator.\n");
		}

	} else {
		printk("NUS notification with 0 length\n");
	}
	return BT_GATT_ITER_CONTINUE;
}

static void discovery_completed(struct bt_gatt_dm *disc, void *ctx)
{
	int err;

	/* Must be statically allocated */
	static struct bt_gatt_subscribe_params param = {
		.notify = on_received,
		.value = BT_GATT_CCC_NOTIFY
	};

	const struct bt_gatt_dm_attr *chrc;
	const struct bt_gatt_dm_attr *desc;

	chrc = bt_gatt_dm_char_by_uuid(disc, BT_UUID_TX);
	if (!chrc) {
		printk("Missing Reader TX characteristic\n");
		goto release;
	}

	desc = bt_gatt_dm_desc_by_uuid(disc, chrc, BT_UUID_TX);
	if (!desc) {
		printk("Missing Reader TX char value descriptor\n");
		goto release;
	}

	param.value_handle = desc->handle,

	desc = bt_gatt_dm_desc_by_uuid(disc, chrc, BT_UUID_GATT_CCC);
	if (!desc) {
		printk("Missing Thingy orientation char CCC descriptor\n");
		goto release;
	}

	param.ccc_handle = desc->handle;

	err = bt_gatt_subscribe(bt_gatt_dm_conn_get(disc), &param);
	if (err) {
		printk("Subscribe failed (err %d)\n", err);
	}

release:
	err = bt_gatt_dm_data_release(disc);
	if (err) {
		printk("Could not release discovery data, err: %d\n", err);
	}
}

static void discovery_service_not_found(struct bt_conn *conn, void *ctx)
{
	printk("Reader NUS service not found!\n");
}

static void discovery_error_found(struct bt_conn *conn, int err, void *ctx)
{
	printk("The discovery procedure failed, err %d\n", err);
}

static struct bt_gatt_dm_cb discovery_cb = {
	.completed = discovery_completed,
	.service_not_found = discovery_service_not_found,
	.error_found = discovery_error_found,
};

static void connected(struct bt_conn *conn, uint8_t conn_err)
{
	int err;
	char addr[BT_ADDR_LE_STR_LEN];

	bt_addr_le_to_str(bt_conn_get_dst(conn), addr, sizeof(addr));

	if (conn_err) {
		printk("Failed to connect to %s (%u)\n", addr, conn_err);
		return;
	}

	printk("Connected: %s\n", addr);

	err = bt_gatt_dm_start(conn, BT_UUID_NUS, &discovery_cb, NULL);
	if (err) {
		printk("Could not start service discovery, err %d\n", err);
	}
}

static struct bt_conn_cb conn_callbacks = {
	.connected = connected,
};

void scan_filter_match(struct bt_scan_device_info *device_info,
		       struct bt_scan_filter_match *filter_match,
		       bool connectable)
{
	char addr[BT_ADDR_LE_STR_LEN];

	bt_addr_le_to_str(device_info->recv_info->addr, addr, sizeof(addr));

	printk("Device found: %s\n", addr);
}

void scan_connecting_error(struct bt_scan_device_info *device_info)
{
	printk("Connection to peer failed!\n");
}

BT_SCAN_CB_INIT(scan_cb, scan_filter_match, NULL, scan_connecting_error, NULL);

static void scan_start(void)
{
	int err;

	struct bt_le_scan_param scan_param = {
		.type = BT_LE_SCAN_TYPE_ACTIVE,
		.options = BT_LE_SCAN_OPT_FILTER_DUPLICATE,
		.interval = 0x0010,
		.window = 0x0010,
	};

	struct bt_scan_init_param scan_init = {
		.connect_if_match = 1,
		.scan_param = &scan_param,
		.conn_param = BT_LE_CONN_PARAM_DEFAULT,
	};

	bt_scan_init(&scan_init);
	bt_scan_cb_register(&scan_cb);

	err = bt_scan_filter_add(BT_SCAN_FILTER_TYPE_UUID, BT_UUID_NUS);
	if (err) {
		printk("Scanning filters cannot be set\n");
		return;
	}

	err = bt_scan_filter_enable(BT_SCAN_UUID_FILTER, false);
	if (err) {
		printk("Filters cannot be turned on\n");
	}

	err = bt_scan_start(BT_SCAN_TYPE_SCAN_ACTIVE);
	if (err) {
		printk("Scanning failed to start, err %d\n", err);
	}

	printk("Scanning...\n");
}

static void ble_ready(int err)
{
	printk("Bluetooth ready\n");

	bt_conn_cb_register(&conn_callbacks);
	scan_start();
}

void ble_init(void)
{
	int err;

	printk("Initializing Bluetooth..\n");
	err = bt_enable(ble_ready);
	if (err) {
		printk("Bluetooth init failed (err %d)\n", err);
		return;
	}
}
```

## src/ble.h
```c
/*
 * Copyright (c) 2018 Nordic Semiconductor ASA
 *
 * SPDX-License-Identifier: LicenseRef-Nordic-5-Clause
 */

#ifndef _BLE_H_
#define _BLE_H_

void ble_init(void);

#endif /* _BLE_H_ */
```

## src/gcloud.c
```c
#include<logging/log.h>

#include <zephyr.h>
#include <kernel.h>
#include <string.h>
#include <errno.h>

#include <date_time.h>

#include <net/mqtt.h>
#include <net/socket.h>
#include <net/tls_credentials.h>

#include <data/jwt.h>

#include <modem/modem_key_mgmt.h>
#include <nrf_modem.h>

#include "gcloud.h"

#define CONFIG_GCLOUD_REGION "us-central1"
#define CONFIG_GCLOUD_PROJECT_NAME "nordic-91-test"
#define CONFIG_GCLOUD_REGISTRY_NAME "nrf9160_testing"
#define CONFIG_GCLOUD_DEVICE_NAME "nrf_960075737"

#define CONFIGURATION_SUBSCRIPTION

#define GCLOUD_ID "projects/" CONFIG_GCLOUD_PROJECT_NAME "/locations/" CONFIG_GCLOUD_REGION "/registries/" CONFIG_GCLOUD_REGISTRY_NAME "/devices/" CONFIG_GCLOUD_DEVICE_NAME

#define GCLOUD_HOSTNAME "mqtt.googleapis.com" 
#define BROKER_ADDR GCLOUD_HOSTNAME
#define BROKER_PORT 8883


#define GCLOUD_CA_CERT_1_SEC_TAG 202 
#define GCLOUD_CA_CERT_2_SEC_TAG 203 
#define GCLOUD_PK_SEC_TAG 10 

#define SUBSCRIBE_ID 42

#define MQTT_LIVE_PERIOD K_SECONDS(55)
#define GCLOUD_DISCONNECT_INTERVAL K_HOURS(12)

#define GCLOUD_CONFIG_TOPIC "/devices/" CONFIG_GCLOUD_DEVICE_NAME "/config"
#define GCLOUD_STATE_TOPIC "/devices/" CONFIG_GCLOUD_DEVICE_NAME "/state"
#define GCLOUD_TOPIC "/devices/" CONFIG_GCLOUD_DEVICE_NAME "/events"

#define JWT_BUFFER_SIZE 256

#define GCLOUD_THREAD_STACK_SIZE 2048

#define GCLOUD_THREAD_PRIORITY 7

LOG_MODULE_REGISTER(gcloud);

/* Buffers for MQTT client. */
static uint8_t rx_buffer[CONFIG_MQTT_MESSAGE_BUFFER_SIZE];
static uint8_t tx_buffer[CONFIG_MQTT_MESSAGE_BUFFER_SIZE];
static uint8_t payload_buffer[CONFIG_MQTT_PAYLOAD_BUFFER_SIZE];

/* MQTT thrad definitions */
static K_THREAD_STACK_DEFINE(mqtt_stack_area, 4096);
static struct k_thread mqtt_thread;
static k_tid_t mqtt_tid;

/* File descriptor */
static struct pollfd fds;
// The following code defines a semaphore, then configures it as a binary semaphore by setting its count to 0 and its limit to 1.
static K_SEM_DEFINE(gc_connected_sem, 0, 1);

extern void gcloud_thread(void *, void *, void *);

enum gcloud_event_type {
    CONNECT,
    PUBLISH_STATE,
    PUBLISH,
    RECONNECT_TIMEOUT,
    DISCONNECT,
    SUBSCRIBE
};

struct empty {};

union gcloud_event_param {
    struct empty connect;
    struct mqtt_publish_message publish_state; // This could be a whole mqtt message, thus allowing custom topics
    struct mqtt_publish_message publish;
    struct empty reconnect_timeout;
    struct empty disconnect;
    struct empty subscribe; // Here we could add the list of topics to be subscribed to
};

struct gcloud_event {
    enum gcloud_event_type type;
    union gcloud_event_param param;
};

static struct mqtt_client client;
static struct sockaddr_storage mqtt_broker;
static struct mqtt_sec_config tls_config;

char jwt_buffer[JWT_BUFFER_SIZE];
static struct mqtt_utf8 jwt_token = {
    .utf8 = jwt_buffer
};
static struct mqtt_utf8 username = {
    .utf8 = "unused",
    .size = sizeof("unused")
};

static struct mqtt_topic gcloud_topics_list[] = {
    {
        .topic = {
            .utf8 = GCLOUD_CONFIG_TOPIC,
            .size = sizeof(GCLOUD_CONFIG_TOPIC) - 1
        },
        .qos = MQTT_QOS_1_AT_LEAST_ONCE
    }
};

/* Private key information */
extern unsigned char zepfull_private_der[256];
extern unsigned int zepfull_private_der_len;

static received_config_handler_t received_config_handler = NULL;

#define N_MESSAGES 3
K_MSGQ_DEFINE(gcloud_msgq, sizeof(struct gcloud_event), N_MESSAGES, 4);

static void mqtt_event_handler(struct mqtt_client *const cli, const struct mqtt_evt *evt);

void reconnect_timer_handler(struct k_timer *timer_id);
K_TIMER_DEFINE(reconnect_timer, reconnect_timer_handler, NULL);

int k_msgq_get_atomic(struct k_msgq *q, void *data, k_timeout_t timeout);
int k_msgq_put_atomic(struct k_msgq *q, void *data, k_timeout_t timeout);

static bool connected = false;
static bool connecting = false;

/**@brief Function to print strings without null-termination
 */
static void data_print(uint8_t *prefix, uint8_t *data, size_t len)
{
	char buf[len + 1];

	memcpy(buf, data, len);
	buf[len] = 0;
	LOG_INF("%s%s", log_strdup(prefix), log_strdup(buf));
}

/**@brief Resolves the configured hostname and
 * initializes the MQTT broker structure
 */
static void broker_init(void)
{
    int err;
    struct addrinfo *result;
    struct addrinfo *addr;
    struct addrinfo hints = {
        .ai_family = AF_INET,
        .ai_socktype = SOCK_STREAM
    };

    err = getaddrinfo(GCLOUD_HOSTNAME, NULL, &hints, &result);
    if (err) {
        LOG_ERR("ERROR: getaddrinfo failed [%d] %s", err, strerror(err));
        return;
    }

    addr = result;
    err = -ENOENT;

    /* Look for address of the broker. */
    while (addr != NULL) {
        /* IPv4 Address. */
        if (addr->ai_addrlen == sizeof(struct sockaddr_in)) {
            struct sockaddr_in *broker4 =
                ((struct sockaddr_in *)&mqtt_broker);

            broker4->sin_addr.s_addr =
                ((struct sockaddr_in *)addr->ai_addr)
                ->sin_addr.s_addr;
            broker4->sin_family = AF_INET;
            broker4->sin_port = htons(BROKER_PORT);
            
            LOG_DBG("IPv4 Address found 0x%08x",
                broker4->sin_addr.s_addr);
            break;
        } else {
            LOG_ERR("ai_addrlen = %u should be %u or %u",
                (unsigned int)addr->ai_addrlen,
                (unsigned int)sizeof(struct sockaddr_in),
                (unsigned int)sizeof(struct sockaddr_in6));
        }

        addr = addr->ai_next;
        break;
    }

    /* Free the address. */
    freeaddrinfo(result);
}

static int make_jwt(char *buffer, size_t buffer_size) {

    int err;
    struct jwt_builder jb;

    /* private key information */
    unsigned char private_der[256];
    unsigned int private_der_len;

    err = jwt_init_builder(&jb, buffer, buffer_size);
    if (err != 0) {
        LOG_ERR("Unable to init JWT builder: %d", err);
        return err;
    }

    /* Get Unix time from modem thread and mask upper bits */
    int64_t ntp;
    date_time_now(&ntp);

    int64_t unixtime = (ntp/1000);    //TODO: Is unix time valid as jwt timestamp?
    int32_t y = (int32_t)unixtime;

    LOG_DBG("Unix Timestamp: %d\n", y);
    int32_t expiry_time = (y + (12 * 60 * 60));
    int32_t issue_time = y;

    err = jwt_add_payload(&jb, expiry_time, issue_time, CONFIG_GCLOUD_PROJECT_NAME);
    if (err != 0) {
        LOG_ERR("Unable to add JWT payload: %d", err);
        return err;
    }

    /* Get private key from the modem */
    err = modem_key_mgmt_read(
        GCLOUD_PK_SEC_TAG,
        MODEM_KEY_MGMT_CRED_TYPE_PRIVATE_CERT,
        private_der,
        &private_der_len);
    if (err != 0) {
        LOG_ERR("Read private key err: [%d] %s\n", err, strerror(err));
        return err;
    }

    /* Sign the jwt with the private key */
    err = jwt_sign(&jb, private_der, private_der_len);
    if (err != 0) {
        LOG_ERR("Unable to add JWT payload: %d", err);
        return err;
    }
    if (jb.overflowed != 0) {
        LOG_ERR("JWT buffer overflowed");
        return -ENOMEM;
    }
    return err;
}

static int gcloud_subscribe() {
    const struct mqtt_subscription_list subscriptions = {
        .list = (struct mqtt_topic *)&gcloud_topics_list,
        .list_count = ARRAY_SIZE(gcloud_topics_list),
        .message_id = SUBSCRIBE_ID
    };

    return mqtt_subscribe(&client, &subscriptions);
}

static int client_init(void) {

    mqtt_client_init(&client);

    int err = make_jwt(jwt_buffer, JWT_BUFFER_SIZE);
    if (err != 0) {
        LOG_ERR("Unable to make jwt: [%d] %s", err, strerror(-err));
        return err;
    }

    LOG_DBG("JWT:\n%s\n", log_strdup(jwt_buffer));
    LOG_DBG("JWT length: %d\n", strlen(jwt_buffer));
    jwt_token.size = strlen(jwt_buffer);

    client.broker = &mqtt_broker;

    /* MQTT client configuration */
    client.evt_cb = mqtt_event_handler;
    client.client_id.utf8 = (uint8_t *)GCLOUD_ID;
    client.client_id.size = strlen(GCLOUD_ID);

	client.password = &jwt_token;
	client.user_name = &username;

    client.protocol_version = MQTT_VERSION_3_1_1;

	/* MQTT buffers configuration */
	client.rx_buf = rx_buffer;
	// client.rx_buf_size = sizeof(rx_buffer);
    client.rx_buf_size = 512;

	client.tx_buf = tx_buffer;
	// client.tx_buf_size = sizeof(tx_buffer);
    client.tx_buf_size = 1024;

    /* MQTT transport configuration */
	client.transport.type = MQTT_TRANSPORT_SECURE;

    /* Session */
    client.clean_session = 1;
    client.keepalive = 120;

    return 0;
}

int gcloud_connect(received_config_handler_t received_config_cb) {
    int err = 0;
    received_config_handler = received_config_cb;

    // send connect command
    struct gcloud_event msg = {
        .type = CONNECT
    };
    err = k_msgq_put_atomic(&gcloud_msgq, &msg, K_FOREVER);

    k_sem_take(&gc_connected_sem, K_FOREVER);

    return err;
}

int gcloud_disconnect() {
    int err = 0;

    // send disconnect command
    struct gcloud_event msg = {
        .type = DISCONNECT
    };
    err = k_msgq_put_atomic(&gcloud_msgq, &msg, K_FOREVER);

    return err;
}

// CANDO: Merge publish functions, and only have one publish command
// (the public API can still have two separate functions)
int gcloud_publish(uint8_t *data, uint32_t size, enum mqtt_qos qos)
{
    int err;
    if (!connected) {
        LOG_WRN("Cannot publish data while not connected to Google Cloud");
        return -ENOTCONN;
    }

    struct gcloud_event cmd = {
        .type = PUBLISH,
        .param.publish = {
            .topic = {
                .topic = {
                    .utf8 = GCLOUD_TOPIC,
                    .size = strlen(GCLOUD_TOPIC)
                },
                .qos = qos
            },
            .payload = {
                .data = data,
                .len = size
            }
        }
    };

    err = k_msgq_put_atomic(&gcloud_msgq, &cmd, K_FOREVER);

    return err;
}

int gcloud_publish_state(uint8_t *data, uint32_t size, enum mqtt_qos qos)
{
    int err;
    if (!connected) {
        LOG_WRN("Cannot publish state while not connected to Google Cloud");
        return -ENOTCONN;
    }
    struct gcloud_event state_cmd = {
        .type = PUBLISH_STATE,
        .param.publish_state = {
            .topic = {
                .topic = {
                    .utf8 = GCLOUD_STATE_TOPIC,
                    .size = strlen(GCLOUD_STATE_TOPIC)
                },
                .qos = qos
            },
            .payload = {
                .data = data,
                .len = size
            }
        }
    };
    err = k_msgq_put_atomic(&gcloud_msgq, &state_cmd, K_FOREVER);
    return err;
}

int k_msgq_get_atomic(struct k_msgq *q, void *data, k_timeout_t timeout){
    unsigned int key = irq_lock();
    int temp = k_msgq_get(q, data, timeout);
    irq_unlock(key);
    return temp;
}

int k_msgq_put_atomic(struct k_msgq *q, void *data, k_timeout_t timeout){
    unsigned int key = irq_lock();
    int temp = k_msgq_put(q,data, timeout);
    irq_unlock(key);
    return temp;
}

void reconnect_timer_handler(struct k_timer *timer_id) {
    struct gcloud_event cmd = {
        .type = RECONNECT_TIMEOUT,
        .param = {}
    };
    int err = k_msgq_put(&gcloud_msgq, &cmd, K_NO_WAIT);

    if (err) {
        LOG_ERR("k_msgq_put (reconnect_timeout) failed: [%d] %s", err, strerror(err));
        // TODO: Find a way to report this error to the application.
    }
}

int gcloud_provision(void) {

    //int err;

    /* Security configuration */
    static sec_tag_t sec_tag_list[] = { 
        GCLOUD_CA_CERT_1_SEC_TAG, 
        GCLOUD_CA_CERT_2_SEC_TAG };

    tls_config = (client.transport).tls.config;

	tls_config.peer_verify = 0;
	tls_config.cipher_list = NULL;
	tls_config.cipher_count = 0;
	tls_config.sec_tag_count = ARRAY_SIZE(sec_tag_list);
	tls_config.sec_tag_list = sec_tag_list;
	tls_config.hostname = GCLOUD_HOSTNAME;
	tls_config.session_cache  = TLS_SESSION_CACHE_DISABLED; //TODO

    return 0;
}

static void mqtt_event_handler(struct mqtt_client *const cli,
                const struct mqtt_evt *evt)
{
    int err = 0;
    LOG_INF("MQTT event: %d", evt->type);

    switch (evt->type) {
        /* Response to connack request */
        case MQTT_EVT_CONNACK:
            LOG_DBG("Got CONNACK");
            if (evt->result != 0) {
                LOG_ERR("MQTT connect failed: [%d] %s", evt->result, strerror(evt->result));
                break;
            }

            k_sem_give(&gc_connected_sem);

            connected = true;
            connecting = false;
            k_timer_start(&reconnect_timer, GCLOUD_DISCONNECT_INTERVAL, GCLOUD_DISCONNECT_INTERVAL);

            #ifdef CONFIGURATION_SUBSCRIPTION
                struct gcloud_event cmd = {
                    .type = SUBSCRIBE,
                    .param.subscribe = {}
                };

                err = k_msgq_put_atomic(&gcloud_msgq, &cmd, K_FOREVER);

                if (err) {
                    LOG_ERR("k_msgq_put_atomic (subscribe) failed: [%d] %s", err, strerror(err));
                    // TODO: Find a way to report this error to the application.
                }
            #endif

            break;

        /* Message has been published to a topic we subscribe to */
        case MQTT_EVT_PUBLISH:
            LOG_DBG("MQTT PUBLISH event");
            const struct mqtt_publish_param *p = &evt->param.publish;

            if (evt->result != 0) {
                LOG_ERR("Publish event error: [%d] %s", evt->result, strerror(-evt->result));
            }

            if (p->message.topic.qos == MQTT_QOS_1_AT_LEAST_ONCE) {
                const struct mqtt_puback_param ack = {
                    .message_id = p->message_id
                };

                /* Send ack */
                mqtt_publish_qos1_ack(&client, &ack);
                LOG_INF("Send acknowledgement for message with ID: %d", p->message_id);
            }

            if(p->message.payload.len <= 2) {
                LOG_WRN("Received empty payload");
                break;
            }

            mqtt_readall_publish_payload(&client, payload_buffer, p->message.payload.len);

            LOG_DBG("Length of payload: %d", p->message.payload.len);
            LOG_DBG("Topic: %s", log_strdup(p->message.topic.topic.utf8));
            LOG_DBG("QoS: %d", p->message.topic.qos);
            data_print("Received: ", payload_buffer,
				p->message.payload.len);
            
            if (received_config_handler != NULL) {
                received_config_handler(&p->message);
            }
            
            break;

        /* Dissconnect event. MQTT Client Reference is no longer valid. */
        case MQTT_EVT_DISCONNECT:
            LOG_DBG("MQTT client disconnected: [%d] %s", evt->result, strerror(-evt->result));
            k_timer_stop(&reconnect_timer);
            // If we are connected, something has gone wrong, and we would like to reconnect
            // CANDO: Notify the application that we are attempting a reconnect
            
            // Purge message queue to make sure that there are no old messages waiting
            k_msgq_purge(&gcloud_msgq);


            if (connected || connecting) {
                err = gcloud_connect(received_config_handler);
                if (err) {
                    LOG_ERR("k_msgq_put_atomic (reconnect) [%d] %s", err, strerror(err));
                    // TODO: Find a way to report this error to the application.
                }
            }
            break;

        /* Acknowledgement for QoS 1 messages */
        case MQTT_EVT_PUBACK:
            if (evt->result != 0) {
                LOG_ERR("MQTT PUBACK error: %d", evt->result);
                break;
            }

            LOG_DBG("PUBACK packet id: %d\n", evt->param.puback.message_id);

            break;

        /* Reception confirmation for messages with QoS 2 */
        case MQTT_EVT_PUBREC:
            if (evt->result != 0) {
                LOG_ERR("MQTT PUBREC error: %d", evt->result);
                break;
            }

            LOG_DBG("PUBREC packet id: %u", evt->param.pubrec.message_id);

            const struct mqtt_pubrel_param rel_param = {
                .message_id = evt->param.pubrec.message_id
            };

            err = mqtt_publish_qos2_release(&client, &rel_param);
            if (err != 0) {
                LOG_ERR("Failed to send MQTT PUBREL: [%d] %s", err, strerror(err));
            }

            break;

        /* Release of messages with QoS 2 */
        case MQTT_EVT_PUBREL:
            LOG_DBG("MQTT PUBREL event");
            if (evt->result != 0) {
                LOG_ERR("PUBREL error: %d", evt->result);
                break;
            }
            break;

        /* Confirmation to publish */
        case MQTT_EVT_PUBCOMP:
            if (evt->result != 0) {
                LOG_ERR("MQTT PUBCOMP error: %d", evt->result);
                break;
            }

            LOG_DBG("PUBCOMP packet id: %u", evt->param.pubcomp.message_id);

            break;

        /* Ack of a subscription request */
        case MQTT_EVT_SUBACK:
            LOG_DBG("Got SUBACK");
            if (evt->result != 0) {
                LOG_ERR("MQTT SUBACK error: %d", evt->result);
                break;
            }

            break;

        /* Ack of an unsubscribe request */
        case MQTT_EVT_UNSUBACK:
            LOG_DBG("MQTT UNSUBACK event");
            if (evt->result != 0) {
                LOG_ERR("MQTT UNSUBACK error: %d", evt->result);
                break;
            }

            break;
        
        default:
            LOG_ERR("Unknown mqtt event type");
            break;
    }
}

/**@brief Initialize the file descriptor structure used by poll.
 */
static int fds_init(struct mqtt_client *c)
{
	if (c->transport.type == MQTT_TRANSPORT_NON_SECURE) {
		fds.fd = c->transport.tcp.sock;
	} else {
#if defined(CONFIG_MQTT_LIB_TLS)
		fds.fd = c->transport.tls.sock;
#else
		return -ENOTSUP;
#endif
	}

	fds.events = POLLIN;

	return 0;
}

void mqtt_thread_func(void *unused1, void *unused2, void *unused3) {
    int err;

    while(1) {
            err = poll(&fds, 1, mqtt_keepalive_time_left(&client));
            if (err < 0) {
                LOG_ERR("poll: %d", errno);
                break;
            }

            err = mqtt_live(&client);
            if ((err != 0) && (err != -EAGAIN)) {
                LOG_ERR("ERROR: mqtt_live: %d", err);
                break;
            }

            if ((fds.revents & POLLIN) == POLLIN) {
                err = mqtt_input(&client);
                if (err != 0) {
                    LOG_ERR("mqtt_input: %d", err);
                    break;
                }
            }

            if ((fds.revents & POLLERR) == POLLERR) {
                LOG_ERR("POLLERR");
                break;
            }

            if ((fds.revents & POLLNVAL) == POLLNVAL) {
                LOG_ERR("POLLNVAL");
                break;
            }
        }
}

extern void gcloud_thread(void *unused1, void *unused2, void *unused3) 
{
    int err;
    bool sent_flag = false;

    struct gcloud_event event;
    struct mqtt_publish_param msg;

    k_timer_init(&reconnect_timer, reconnect_timer_handler, NULL);

    LOG_INF("Google Cloud Thread Running\n");
    while (true) {

        k_msgq_get_atomic(&gcloud_msgq, &event, K_FOREVER);

        switch (event.type) {
            case CONNECT:
                LOG_INF("Got CONNECT command");
                LOG_DBG("Initiating broker");
                broker_init();

                LOG_DBG("Making JWT");
                make_jwt(jwt_buffer, JWT_BUFFER_SIZE);

                LOG_DBG("Initiating client");
                client_init();

                LOG_DBG("Connecting mqtt");
                connecting = true;
                err = mqtt_connect(&client);
                if (err) {
                    LOG_ERR("mqtt_connect failed: [%d] %s", err, strerror(-err));
                    // TODO: Find a way to report this error to the application.
                }
                err = fds_init(&client);
	            if (err != 0) {
	            	LOG_ERR("fds_init: [%d] %s", err, strerror(-err));
	            }

                /* Initialise MQTT thread */
                mqtt_tid = k_thread_create(&mqtt_thread, mqtt_stack_area, K_THREAD_STACK_SIZEOF(mqtt_stack_area),
                             (k_thread_entry_t)mqtt_thread_func, NULL, NULL, NULL,
                             7, 0, K_NO_WAIT);


                break;
            case PUBLISH_STATE:
            if (connected) {
                LOG_DBG("Got PUBLISH_STATE command");
                msg.message = event.param.publish_state;
                msg.message_id = k_uptime_get_32();
                msg.dup_flag = 0;
                msg.retain_flag = 0;
                err = mqtt_publish(&client, &msg);
                
                if (err) {
                    LOG_ERR("mqtt_publish (state) failed: [%d] %s", err, strerror(-err));
                    // TODO: Find a way to report this error to the application.
                }
            };
            break;
            // CANDO: Merge these publish cases?
            case PUBLISH:
            if (connected) {
                LOG_DBG("Got PUBLISH command");
                msg.message = event.param.publish;
                msg.message_id = k_uptime_get_32();
                msg.dup_flag = 0;
                msg.retain_flag = 0;
                err = mqtt_publish(&client, &msg);
                if (err) {
                    LOG_ERR("mqtt_publish failed: [%d] %s", err, strerror(-err));
                    // TODO: Find a way to report this error to the application.
                }
                sent_flag = true;
            };
            break;
            case RECONNECT_TIMEOUT:
                LOG_DBG("Got RECONNECT_TIMEOUT command");
            case DISCONNECT:
                LOG_DBG("Got DISCONNECT command");
            if (connected) {
                k_timer_stop(&reconnect_timer);
                LOG_DBG("Disconnecting mqtt");
                err = mqtt_disconnect(&client);
                if (err) {
                    LOG_ERR("mqtt_disconnect (reconnect) failed: [%d] %s", err, strerror(-err));
                    // TODO: Find a way to report this error to the application.
                }
                /* purge message queue */
                k_msgq_purge(&gcloud_msgq);
                k_thread_abort(mqtt_tid);
                connected = false;
                if (event.type == DISCONNECT) {
                    LOG_DBG("Not setting connecting flag");
                    connecting = false;
                } else {
                    connecting = true;
                }

            };
            break;
            case SUBSCRIBE:
            if (connected) {
                LOG_DBG("Got SUBSCRIBE command");
                err = gcloud_subscribe();
                if (err) {
                    LOG_ERR("gcloud_subscribe failed: [%d] %s", err, strerror(-err));
                    // TODO: Find a way to report this error to the application.
                }
            };
            break;
            default:
                LOG_ERR("Unknown event type received");
                // TODO: Find a way to report this error to the application.
        }
        /* If a message has been sent */
        if (sent_flag == true) {
           sent_flag = false;
        }
    }
}
```

## src/gcloud_iot.h
```c
/*
 * Copyright (c) 2018 Linaro Ltd
 *
 * SPDX-License-Identifier: Apache-2.0
 */

#ifndef GCLOUD_IOT_H__
#define GCLOUD_IOT_H__

#include <net/socket.h>

int gcloud_iot_client_init(void);


#endif //GCLOUD_IOT_H__
```

## src/protocol.h
```c
/*
 * Copyright (c) 2018 Linaro Ltd
 *
 * SPDX-License-Identifier: Apache-2.0
 */

/*
 * MQTT-based cloud protocol engine.
 */

#ifndef PROTOCOL_H__
#define PROTOCOL_H__

#include <net/socket.h>

void mqtt_startup(char *hostname, int port);

#endif
```
